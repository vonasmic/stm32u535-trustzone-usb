/* HAL sources compiled into stm32u5xx_it.o.
 * CubeIDE is not emitting Drivers objects for NonSecure. Do not add this
 * file as its own translation unit. If CubeIDE later compiles Drivers,
 * drop these includes to avoid duplicate symbols.
 */
#include "../../../Drivers/STM32U5xx_HAL_Driver/Src/stm32u5xx_hal.c"
#include "../../../Drivers/STM32U5xx_HAL_Driver/Src/stm32u5xx_hal_cortex.c"
#include "../../../Drivers/STM32U5xx_HAL_Driver/Src/stm32u5xx_hal_dma.c"
#include "../../../Drivers/STM32U5xx_HAL_Driver/Src/stm32u5xx_hal_dma_ex.c"
#include "../../../Drivers/STM32U5xx_HAL_Driver/Src/stm32u5xx_hal_exti.c"
#include "../../../Drivers/STM32U5xx_HAL_Driver/Src/stm32u5xx_hal_flash.c"
#include "../../../Drivers/STM32U5xx_HAL_Driver/Src/stm32u5xx_hal_flash_ex.c"
#include "../../../Drivers/STM32U5xx_HAL_Driver/Src/stm32u5xx_hal_gpio.c"
#include "../../../Drivers/STM32U5xx_HAL_Driver/Src/stm32u5xx_hal_gtzc.c"
#include "../../../Drivers/STM32U5xx_HAL_Driver/Src/stm32u5xx_hal_i2c.c"
#include "../../../Drivers/STM32U5xx_HAL_Driver/Src/stm32u5xx_hal_i2c_ex.c"
#include "../../../Drivers/STM32U5xx_HAL_Driver/Src/stm32u5xx_hal_icache.c"
#include "../../../Drivers/STM32U5xx_HAL_Driver/Src/stm32u5xx_hal_pcd.c"
#include "../../../Drivers/STM32U5xx_HAL_Driver/Src/stm32u5xx_hal_pcd_ex.c"
#include "../../../Drivers/STM32U5xx_HAL_Driver/Src/stm32u5xx_hal_pwr.c"
#include "../../../Drivers/STM32U5xx_HAL_Driver/Src/stm32u5xx_hal_pwr_ex.c"
#include "../../../Drivers/STM32U5xx_HAL_Driver/Src/stm32u5xx_hal_rcc.c"
#include "../../../Drivers/STM32U5xx_HAL_Driver/Src/stm32u5xx_hal_rcc_ex.c"
#include "../../../Drivers/STM32U5xx_HAL_Driver/Src/stm32u5xx_hal_rtc.c"
#include "../../../Drivers/STM32U5xx_HAL_Driver/Src/stm32u5xx_hal_rtc_ex.c"
#include "../../../Drivers/STM32U5xx_HAL_Driver/Src/stm32u5xx_ll_usb.c"
